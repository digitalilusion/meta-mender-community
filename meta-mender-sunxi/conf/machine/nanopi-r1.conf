## meta-mender-sunxi/conf/machine/nanopi-r1.conf
```bitbake
#@TYPE: Machine
#@NAME: nanopi R1
#@DESCRIPTION: Machine configuration for the FriendlyARM NanoPi Neo, based on the Allwinner H3 CPU

require conf/machine/include/sun8i.inc

KERNEL_DEVICETREE = "sun8i-h3-nanopi-r1.dtb"
UBOOT_MACHINE = "nanopi_r1_defconfig"

PREFERRED_PROVIDER_virtual/kernel=  "linux-friendlyarm"
```
